## boards/arm/arduino_nano_33_iot/arduino_nano_33_iot_defconfig
```kconfig
# SPDX-License-Identifier: Apache-2.0

CONFIG_SOC_SERIES_SAMD21=y
CONFIG_SOC_PART_NUMBER_SAMD21G18A=y
CONFIG_BOARD_ARDUINO_NANO_33_IOT=y
CONFIG_SOC_ATMEL_SAMD_OSC8M_AS_MAIN=y
CONFIG_CORTEX_M_SYSTICK=y
CONFIG_CONSOLE=y
CONFIG_UART_CONSOLE=y
CONFIG_UART_INTERRUPT_DRIVEN=y
CONFIG_SERIAL=y
CONFIG_PINMUX=y
CONFIG_USE_DT_CODE_PARTITION=y

CONFIG_LOG=y
#CONFIG_LOG_BACKEND_UART=y
CONFIG_NET_OFFLOAD=y
CONFIG_WIFI_NINA=y
CONFIG_WIFI_LOG_LEVEL_DBG=y

CONFIG_SPI=y
CONFIG_GPIO=y

CONFIG_SHELL=y
CONFIG_NET_DEFAULT_IF_OFFLOAD=y
#CONFIG_NET_SOCKETS_OFFLOAD=y
CONFIG_NET_CONFIG_INIT_TIMEOUT=1
#CONFIG_NET_SOCKETS_OFFLOAD=y
CONFIG_DNS_RESOLVER=y
CONFIG_NET_IF_LOG_LEVEL_DBG=y
CONFIG_NET_CONTEXT_LOG_LEVEL_DBG=y
CONFIG_NET_NATIVE=y
```

## dts/bindings/arm/atmel,sam0-eic.yaml
```yaml
#
# Copyright (c) 2018 Google LLC.
#
# SPDX-License-Identifier: Apache-2.0
#
---
title: Atmel SAM0 External Interrupt Controller
id: atmel,sam0-eic
version: 0.1

description: >
    Atmel SAM0 External Interrupt Controller binding

properties:
    compatible:
      type: string
      category: required
      description: compatible strings
      constraint: "atmel,sam0-eic"

    reg:
      type: array
      description: mmio register space
      generation: define
      category: required

    interrupts:
      type: array
      category: required
      description: required interrupts
      generation: define

    label:
      type: string
      category: required
      description: Human readable string describing the device (used by Zephyr for API name)
      generation: define
...
```

## dts/bindings/dac/atmel,sam0-dac.yaml
```yaml
# Copyright (c) 2020 Google LLC.
# SPDX-License-Identifier: Apache-2.0

description: Atmel SAM0 family DAC

compatible: "atmel,sam0-dac"

include: dac-controller.yaml

properties:
    reg:
      required: true

    clocks:
      required: true

    clock-names:
      required: true

    label:
      required: true

    reference:
      type: string
      required: false
      description: Reference voltage source
      enum:
        - "int1v"
        - "avcc"
        - "vrefp"

    "#io-channel-cells":
      const: 1

io-channel-cells:
    - output
```
